#include <TensorFlowLite.h>
#include "network_model.h"
#include "tensorflow/lite/micro/kernels/micro_ops.h"
#include "tensorflow/lite/micro/micro_error_reporter.h"
#include "tensorflow/lite/micro/micro_interpreter.h"
#include "tensorflow/lite/micro/micro_mutable_op_resolver.h"
#include "tensorflow/lite/schema/schema_generated.h"
#include "tensorflow/lite/version.h"

#define NUM_SAMPLES 10
#define NUMBER_OF_INPUTS 38
#define NUMBER_OF_OUTPUTS 1
#define TENSOR_ARENA_SIZE 80*1024

uint8_t tensor_arena[TENSOR_ARENA_SIZE];
tflite::ErrorReporter* error_reporter;
tflite::MicroInterpreter* interpreter;
TfLiteTensor* input;
TfLiteTensor* output;

const float X_test[NUM_SAMPLES][38] = {
    {-0.11024922321249885, -0.12470615670462065, 1.0873051789289023,
    -0.7362346401101137, -0.00776224074056876, -0.004918644383724874,
    -0.08948642202040107, -0.09507567152556495, -0.8092618187059747,
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    -0.3763870260680415, 0.6528228780141483}
};



const uint8_t y_test[NUM_SAMPLES] = {0, 0, 0, 0, 1, 0, 0, 1, 0, 0}; // Actual labels for each sample

void setup() {
    Serial.begin(115200);
    while (!Serial);
    Serial.println("Starting...");

    static tflite::MicroErrorReporter micro_error_reporter;
    error_reporter = &micro_error_reporter;

    const tflite::Model* model = tflite::GetModel(network_model);
    if (model->version() != TFLITE_SCHEMA_VERSION) {
        Serial.println("Model version does not match schema version.");
        return;
    }

    static tflite::MicroMutableOpResolver<10> micro_op_resolver;
    micro_op_resolver.AddFullyConnected();
    micro_op_resolver.AddSoftmax();
    micro_op_resolver.AddQuantize();
    micro_op_resolver.AddDequantize();

    static tflite::MicroInterpreter static_interpreter(model, micro_op_resolver, tensor_arena, TENSOR_ARENA_SIZE, error_reporter);
    interpreter = &static_interpreter;

    if (interpreter->AllocateTensors() != kTfLiteOk) {
        Serial.println("Failed to allocate tensors!");
        while (1);
    }
    Serial.println("Tensor allocation successful.");

    input = interpreter->input(0);
    output = interpreter->output(0);
}

void loop() {
    for (uint8_t i = 0; i < NUM_SAMPLES; i++) {
        // Load the i-th test sample data into the input tensor
        for (int j = 0; j < NUMBER_OF_INPUTS; j++) {
            input->data.f[j] = X_test[i][j];
        }

        // Run the model on this input and check for error
        if (interpreter->Invoke() != kTfLiteOk) {
            Serial.println("Failed to invoke!");
            continue;
        }

        // Question 6: Deploying the Quantized Mode
        // (a) mplement code to obtain the prediction from the output tensor and determine the predicted class label.
        float prediction = output->data.f[0];
        int predicted_class = (prediction >= 0.5) ? 1 : 0;

        // (b) Implement code to output Sample #, Predicted Class, and Actual Class for each sample to the serial monitor using Serial.print function.
        Serial.print("Sample #"); Serial.println(i);
        Serial.print("Predicted Class: "); Serial.println(predicted_class);
        Serial.print("Actual Class: "); Serial.println(y_test[i]);
        Serial.println();


        // Delay between predictions
        delay(1000);
    }

    // Delay before repeating the tests
    delay(10000);
}
